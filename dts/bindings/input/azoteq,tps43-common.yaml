## dts/bindings/input/azoteq,tps43-common.yaml
```yaml
properties:
  rdy-gpios:
    type: phandle-array
    required: false
    description: GPIO pin for RDY interrupt signal (Ready)

  rst-gpios:
    type: phandle-array
    required: false
    description: GPIO pin for RST reset signal (Reset)

  filter-settings:
    type: int
    default: 0x0F
    description: |
      Bit definitions:
      - Bit 0 (0x01): IIR filter - infinite impulse response filter for
        coordinate smoothing. Reduces high-frequency noise and jitter.
      - Bit 1 (0x02): MAV filter - moving average filter for coordinate
        stabilization. Removes outliers and averages recent measurements.
      - Bit 2 (0x04): IIR select - When set, uses fixed IIR coefficient.
        When clear (default), uses dynamic IIR that adapts to movement speed.
      - Bit 3 (0x08): ALP count filter - Adaptive Learning Process filter
        for noise suppression. Filters unwanted touch events based on learned patterns.
      
      Common configurations:
      - 0x0B: IIR + MAV + ALP enabled, dynamic IIR.
        Good balance of stability and responsiveness.
      - 0x0F (default): All filters enabled including fixed IIR select.
        Maximum smoothing, may introduce increased latency.
      - 0x03: IIR + MAV only. Basic smoothing without ALP filtering.
      - 0x01: IIR only. Minimal filtering, lowest latency.
      - 0x00: All filters disabled. Raw sensor data, may have noise.
      
      Values can be combined using bitwise OR (e.g., 0x01 | 0x02 = 0x03).
      
  filter-dynamic-bottom:
    type: int
    required: false
    description: |
      XY dynamic filter bottom beta
      Controls the minimum filtering applied to touch coordinates.
      Lower values reduce smoothing at low speeds, improving responsiveness.
      See datasheet section 5.9.2.1. Only written if explicitly set.

  filter-dynamic-lower:
    type: int
    required: false
    description: |
      XY dynamic filter lower speed threshold 
      Defines the speed below which the bottom beta filter coefficient is used.
      Only written if explicitly set.

  filter-dynamic-upper:
    type: int
    required: false
    description: |
      XY dynamic filter upper speed threshold 
      Defines the speed above which maximum filtering is applied.
      Only written if explicitly set.

  x-resolution:
    type: int
    required: false
    description: |
      X axis resolution in pixels
      Sets the trackpad X resolution. Only written if explicitly set.

  y-resolution:
    type: int
    required: false
    description: |
      Y axis resolution in pixels
      Sets the trackpad Y resolution. Only written if explicitly set.

  sensitivity:
    type: int
    required: false
    default: 100
    description: Touch sensitivity percentage (100 = normal, higher = more sensitive)

  scroll-sensitivity:
    type: int
    required: false
    default: 50
    description: Scroll sensitivity percentage (50 = normal, higher = more sensitive)

  enable-power-management:
    type: boolean
    required: false
    description: Enable automatic power management (suspend/resume)

  single-tap:
    type: boolean
    required: false
    description: Enable single tap gesture

  two-finger-tap:
    type: boolean
    required: false
    description: Enable two-finger tap gesture

  scroll:
    type: boolean
    required: false
    description: Enable scroll gesture

  swipes:
    type: boolean
    required: false
    description: Enable swipe processing. When enabled, tracks three-finger swipes as INPUT_BTN_NORTH/SOUTH/EAST/WEST.

  switch-xy:
    type: boolean
    required: false
    description: Swap X and Y axes

  press-and-hold:
    type: boolean
    required: false
    description: Enable press and hold gesture

  invert-x:
    type: boolean
    description: If present, invert X coordinate values.
      
  invert-y:
    type: boolean
    description: If present, invert Y coordinate values.

  invert-scroll-x:
    type: boolean
    description: If present, invert X scroll values.
            
  invert-scroll-y:
    type: boolean
    description: If present, invert Y scroll values.

  swipe-initial-distance:
    type: int
    required: false
    description: |
      Swipe initial distance in pixels.
      Sets the minimum distance a finger must travel to trigger a swipe gesture.
      Written to the SWIPE_INITIAL_DISTANCE register (0x06C1).
      Only written if explicitly set.

  swipe-initial-time:
    type: int
    required: false
    description: |
      Swipe initial time in milliseconds.
      Sets the maximum time allowed for the initial swipe movement.
      Written to the SWIPE_INITIAL_TIME register (0x06BF).
      Only written if explicitly set.

  swipe-angle:
    type: int
    required: false
    description: |
      Swipe angle in degrees.
      Sets the maximum deviation angle for a swipe gesture.
      The value is specified in degrees and internally converted to
      64*tan(angle) before writing to the SWIPE_ANGLE register (0x06C7).
      Only written if explicitly set.

  swipe-consecutive-distance:
    type: int
    required: false
    description: |
      Swipe consecutive distance in pixels.
      Sets the distance threshold for consecutive swipe segments.
      Written to the SWIPE_CONSECUTIVE_DISTANCE register (0x06C5).
      Only written if explicitly set.

  swipe-consecutive-time:
    type: int
    required: false
    description: |
      Swipe consecutive time in milliseconds.
      Sets the time threshold for consecutive swipe segments.
      Written to the SWIPE_CONSECUTIVE_TIME register (0x06C3).
      Only written if explicitly set.

  scroll-initial-distance:
    type: int
    required: false
    description: |
      Scroll initial distance in pixels.
      Sets the minimum distance for a scroll gesture to trigger.
      Written to the SCROLL_INITIAL_DISTANCE register (0x06C8).
      Only written if explicitly set.

  scroll-angle:
    type: int
    required: false
    description: |
      Scroll angle in degrees.
      Sets the maximum deviation angle for a scroll gesture.
      The value is specified in degrees and internally converted to
      64*tan(angle) before writing to the SCROLL_ANGLE register (0x06CA).
      Only written if explicitly set.

  zoom-initial-distance:
    type: int
    required: false
    description: |
      Zoom initial distance in pixels.
      Sets the minimum distance for a zoom gesture to trigger.
      Written to the ZOOM_INITIAL_DISTANCE register (0x06CB).
      Only written if explicitly set.

  zoom-consecutive-distance:
    type: int
    required: false
    description: |
      Zoom consecutive distance in pixels.
      Sets the distance threshold for consecutive zoom segments.
      Written to the ZOOM_CONSECUTIVE_DISTANCE register (0x06CD).
      Only written if explicitly set.
```
